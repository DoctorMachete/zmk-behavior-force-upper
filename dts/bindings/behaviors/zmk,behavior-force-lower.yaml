## dts/bindings/behaviors/zmk,behavior-force-lower.yaml
```yaml
# Copyright (c) 2025 The ZMK Contributors
# SPDX-License-Identifier: MIT

description: Force Lowercase Behavior

compatible: "zmk,behavior-force-lower"

include: one_param.yaml
```

## dts/bindings/behaviors/zmk,behavior-force-upper.yaml
```yaml
# Copyright (c) 2025 The ZMK Contributors
# SPDX-License-Identifier: MIT

description: Force Uppercase Behavior

compatible: "zmk,behavior-force-upper"

include: one_param.yaml
```
