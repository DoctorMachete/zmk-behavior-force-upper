/*
 * Copyright (c) 2025 The ZMK Contributors
 *
 * SPDX-License-Identifier: MIT
 */

/ {
    behaviors {
        /omit-if-no-ref/ fucase: fucase {
            compatible = "zmk,behavior-force-upper";
            #binding-cells = <1>;
        };

        /omit-if-no-ref/ flcase: fucase {
            compatible = "zmk,behavior-force-lower";
            #binding-cells = <1>;
        };
    };
};
